## buildroot-external/Config.in
```kconfig
source "$BR2_EXTERNAL_HASSOS_PATH/package/hassio/Config.in"
source "$BR2_EXTERNAL_HASSOS_PATH/package/bluetooth-bcm43xx/Config.in"
source "$BR2_EXTERNAL_HASSOS_PATH/package/bluetooth-rtl8723/Config.in"
source "$BR2_EXTERNAL_HASSOS_PATH/package/hardkernel-boot/Config.in"
source "$BR2_EXTERNAL_HASSOS_PATH/package/qemu-guest-agent/Config.in"
source "$BR2_EXTERNAL_HASSOS_PATH/package/intel-e1000e/Config.in"
source "$BR2_EXTERNAL_HASSOS_PATH/package/rpi-eeprom/Config.in"

source "$BR2_EXTERNAL_HASSOS_PATH/package/multilib32/Config.in"
source "$BR2_EXTERNAL_HASSOS_PATH/package/recovery-system/Config.in"

menu "eQ-3 HomeMatic Services"
  source "$BR2_EXTERNAL_HASSOS_PATH/package/occu/Config.in"
  source "$BR2_EXTERNAL_HASSOS_PATH/package/cloudmatic/Config.in"
  source "$BR2_EXTERNAL_HASSOS_PATH/package/hmlangw/Config.in"
endmenu

menu "Kernel Module Support"
  source "$BR2_EXTERNAL_HASSOS_PATH/package/generic_raw_uart/Config.in"
  source "$BR2_EXTERNAL_HASSOS_PATH/package/bcm2835_raw_uart/Config.in"
  source "$BR2_EXTERNAL_HASSOS_PATH/package/eq3_char_loop/Config.in"
endmenu

menu "Hardware Support"
  source "$BR2_EXTERNAL_HASSOS_PATH/package/rpi-rf-mod/Config.in"
  source "$BR2_EXTERNAL_HASSOS_PATH/package/rx8130-rtc/Config.in"
  source "$BR2_EXTERNAL_HASSOS_PATH/package/susvd/Config.in"
  source "$BR2_EXTERNAL_HASSOS_PATH/package/piusvd/Config.in"
  source "$BR2_EXTERNAL_HASSOS_PATH/package/picod/Config.in"
  source "$BR2_EXTERNAL_HASSOS_PATH/package/strompi2d/Config.in"
  source "$BR2_EXTERNAL_HASSOS_PATH/package/pidesktopd/Config.in"
  source "$BR2_EXTERNAL_HASSOS_PATH/package/argononed/Config.in"
  source "$BR2_EXTERNAL_HASSOS_PATH/package/bluetooth-tinker/Config.in"
  source "$BR2_EXTERNAL_HASSOS_PATH/package/intel-e1000e/Config.in"
endmenu

menu "Software Support"
  source "$BR2_EXTERNAL_HASSOS_PATH/package/detect_radio_module/Config.in"
  source "$BR2_EXTERNAL_HASSOS_PATH/package/daemonize/Config.in"
  source "$BR2_EXTERNAL_HASSOS_PATH/package/ssdpd/Config.in"
  source "$BR2_EXTERNAL_HASSOS_PATH/package/eq3configd/Config.in"
  source "$BR2_EXTERNAL_HASSOS_PATH/package/wiringpi-rpi/Config.in"
  source "$BR2_EXTERNAL_HASSOS_PATH/package/wiringpi-tinker/Config.in"
  source "$BR2_EXTERNAL_HASSOS_PATH/package/neoserver/Config.in"
  source "$BR2_EXTERNAL_HASSOS_PATH/package/rndaddtoentcnt/Config.in"
  source "$BR2_EXTERNAL_HASSOS_PATH/package/qemu-guest-agent/Config.in"
  source "$BR2_EXTERNAL_HASSOS_PATH/package/raspi-fanshim/Config.in"
endmenu

menu "Java Runtime Environment"
  source "$BR2_EXTERNAL_HASSOS_PATH/package/java-azul/Config.in"
endmenu

# External packages
#source "$BR2_EXTERNAL_HASSOS_PATH/Config.ext.in"
```

## buildroot-external/configs/rpi3_defconfig
```kconfig
BR2_arm=y
BR2_cortex_a53=y
BR2_ARM_FPU_VFPV4=y
BR2_DL_DIR="/cache/dl"
BR2_CCACHE=y
BR2_CCACHE_DIR="/cache/cc"
BR2_GLOBAL_PATCH_DIR="$(BR2_EXTERNAL_HASSOS_PATH)/patches $(BR2_EXTERNAL_HASSOS_PATH)/board/raspberrypi/patches"
BR2_TOOLCHAIN_BUILDROOT_GLIBC=y
BR2_GCC_VERSION_9_X=y
BR2_OPTIMIZE_2=y
BR2_SSP_REGULAR=y
BR2_SSP_OPTION="-fstack-protector"
BR2_TOOLCHAIN_BUILDROOT_CXX=y
BR2_BINUTILS_ENABLE_LTO=y
BR2_GCC_ENABLE_LTO=y
BR2_TARGET_GENERIC_HOSTNAME="homeassistant"
BR2_TARGET_GENERIC_ISSUE="Welcome to Home Assistant"
BR2_INIT_SYSTEMD=y
BR2_TARGET_GENERIC_GETTY_PORT="tty1"
# BR2_TARGET_GENERIC_REMOUNT_ROOTFS_RW is not set
BR2_ROOTFS_OVERLAY="$(BR2_EXTERNAL_HASSOS_PATH)/rootfs-overlay $(BR2_EXTERNAL_HASSOS_PATH)/board/raspberrypi/rootfs-overlay"
BR2_ROOTFS_POST_BUILD_SCRIPT="$(BR2_EXTERNAL_HASSOS_PATH)/scripts/post-build.sh"
BR2_ROOTFS_POST_IMAGE_SCRIPT="$(BR2_EXTERNAL_HASSOS_PATH)/scripts/post-image.sh"
BR2_ROOTFS_POST_SCRIPT_ARGS="$(BR2_EXTERNAL_HASSOS_PATH)/board/raspberrypi/rpi3 $(BR2_EXTERNAL_HASSOS_PATH)/board/raspberrypi/hassos-hook.sh"

BR2_LINUX_KERNEL=y
BR2_LINUX_KERNEL_CUSTOM_TARBALL=y
BR2_LINUX_KERNEL_CUSTOM_TARBALL_LOCATION="https://github.com/raspberrypi/linux/archive/9797f1a4938c20139b00a25de93cc99efb5c291b.tar.gz"
BR2_LINUX_KERNEL_DEFCONFIG="bcm2709"
BR2_LINUX_KERNEL_CONFIG_FRAGMENT_FILES="$(BR2_EXTERNAL_HASSOS_PATH)/kernel/hassos.config $(BR2_EXTERNAL_HASSOS_PATH)/kernel/docker.config $(BR2_EXTERNAL_HASSOS_PATH)/kernel/device-support.config $(BR2_EXTERNAL_HASSOS_PATH)/board/raspberrypi/kernel.config"
BR2_LINUX_KERNEL_LZ4=y
BR2_LINUX_KERNEL_DTS_SUPPORT=y
BR2_LINUX_KERNEL_INTREE_DTS_NAME="bcm2710-rpi-3-b bcm2710-rpi-3-b-plus bcm2710-rpi-cm3"
BR2_LINUX_KERNEL_NEEDS_HOST_OPENSSL=y
BR2_LINUX_KERNEL_NEEDS_HOST_LIBELF=y

#BR2_LINUX_KERNEL_CUSTOM_TARBALL_LOCATION="$(call github,raspberrypi,linux,raspberrypi-kernel_1.20201022-1)/linux-raspberrypi-kernel_1.20201022-1.tar.gz"
BR2_LINUX_KERNEL_PATCH="$(BR2_EXTERNAL_EQ3_PATH)/board/raspberrypi3/kernel-patches"
BR2_LINUX_KERNEL_USE_CUSTOM_CONFIG=y
BR2_LINUX_KERNEL_CUSTOM_CONFIG_FILE="$(BR2_EXTERNAL_EQ3_PATH)/board/raspberrypi3/kernel_defconfig"
#BR2_LINUX_KERNEL_INTREE_DTS_NAME="broadcom/bcm2710-rpi-3-b broadcom/bcm2837-rpi-3-b broadcom/bcm2710-rpi-3-b-plus broadcom/bcm2837-rpi-3-b-plus broadcom/bcm2710-rpi-2-b broadcom/bcm2710-rpi-cm3 broadcom/bcm2837-rpi-3-a-plus broadcom/bcm2837-rpi-cm3-io3"

BR2_PACKAGE_BUSYBOX_CONFIG="$(BR2_EXTERNAL_HASSOS_PATH)/busybox.config"
BR2_PACKAGE_BUSYBOX_INDIVIDUAL_BINARIES=y
BR2_PACKAGE_PROCPS_NG=y
BR2_PACKAGE_JQ=y
BR2_PACKAGE_E2FSPROGS=y
BR2_PACKAGE_E2FSPROGS_RESIZE2FS=y
BR2_PACKAGE_SQUASHFS=y
BR2_PACKAGE_RPI_FIRMWARE=y
BR2_PACKAGE_RPI_WIFI_FIRMWARE=y
BR2_PACKAGE_CRDA=y
BR2_PACKAGE_GPTFDISK=y
BR2_PACKAGE_GPTFDISK_SGDISK=y
BR2_PACKAGE_UBOOT_TOOLS=y
BR2_PACKAGE_CA_CERTIFICATES=y
BR2_PACKAGE_LIBDNET=y
BR2_PACKAGE_LIBCGROUP=y
BR2_PACKAGE_LIBCGROUP_TOOLS=y
BR2_PACKAGE_BLUEZ5_UTILS=y
BR2_PACKAGE_BLUEZ5_UTILS_CLIENT=y
BR2_PACKAGE_DHCP=y
BR2_PACKAGE_DHCP_CLIENT=y
BR2_PACKAGE_WIREGUARD_LINUX_COMPAT=y
BR2_PACKAGE_DROPBEAR=y
BR2_PACKAGE_DROPBEAR_CLIENT=y
# BR2_PACKAGE_IFUPDOWN_SCRIPTS is not set
BR2_PACKAGE_NETWORK_MANAGER=y
BR2_PACKAGE_TINI=y
BR2_PACKAGE_DOCKER_ENGINE=y
BR2_PACKAGE_DOCKER_CLI=y
BR2_PACKAGE_RAUC=y
BR2_PACKAGE_RAUC_NETWORK=y
BR2_PACKAGE_RNG_TOOLS=y
# BR2_PACKAGE_SYSTEMD_HWDB is not set
# BR2_PACKAGE_SYSTEMD_NETWORKD is not set
BR2_PACKAGE_SYSTEMD_RANDOMSEED=y
BR2_PACKAGE_SYSTEMD_RESOLVED=y
BR2_PACKAGE_SYSTEMD_COREDUMP=y
BR2_PACKAGE_SYSTEMD_LOGIND=y
BR2_PACKAGE_UTIL_LINUX_PARTX=y
BR2_PACKAGE_UTIL_LINUX_ZRAMCTL=y
BR2_PACKAGE_UTIL_LINUX_LOGIN=y
BR2_PACKAGE_UTIL_LINUX_NOLOGIN=y
BR2_PACKAGE_USB_MODESWITCH=y
BR2_PACKAGE_USB_MODESWITCH_DATA=y
BR2_TARGET_ROOTFS_SQUASHFS=y
BR2_TARGET_ROOTFS_SQUASHFS4_LZ4=y
# BR2_TARGET_ROOTFS_TAR is not set
BR2_TARGET_UBOOT=y
BR2_TARGET_UBOOT_BUILD_SYSTEM_KCONFIG=y
BR2_TARGET_UBOOT_CUSTOM_VERSION=y
BR2_TARGET_UBOOT_CUSTOM_VERSION_VALUE="2020.10"
BR2_TARGET_UBOOT_BOARD_DEFCONFIG="rpi_3_32b"
BR2_TARGET_UBOOT_CONFIG_FRAGMENT_FILES="$(BR2_EXTERNAL_HASSOS_PATH)/bootloader/uboot.config $(BR2_EXTERNAL_HASSOS_PATH)/board/raspberrypi/uboot.config"
BR2_PACKAGE_HOST_UBOOT_TOOLS=y
BR2_PACKAGE_HOST_UBOOT_TOOLS_BOOT_SCRIPT=y
BR2_PACKAGE_HOST_UBOOT_TOOLS_BOOT_SCRIPT_SOURCE="$(BR2_EXTERNAL_HASSOS_PATH)/board/raspberrypi/uboot-boot.ush"
BR2_PACKAGE_HOST_LINUX_HEADERS_CUSTOM_5_4=y
BR2_PACKAGE_HOST_DOSFSTOOLS=y
BR2_PACKAGE_HOST_E2FSPROGS=y
BR2_PACKAGE_HOST_GPTFDISK=y
BR2_PACKAGE_HOST_MTOOLS=y
BR2_PACKAGE_HOST_RAUC=y
BR2_PACKAGE_HASSIO=y
BR2_PACKAGE_HASSIO_ARCH="armv7"
BR2_PACKAGE_HASSIO_MACHINE="raspberrypi3"
BR2_PACKAGE_APPARMOR=y
BR2_PACKAGE_APPARMOR_PROFILES=y
BR2_PACKAGE_BLUETOOTH_BCM43XX=y
BR2_PACKAGE_DOSFSTOOLS=y
BR2_PACKAGE_DOSFSTOOLS_FSCK_FAT=y

BR2_aarch64=y
BR2_KERNEL_MIRROR="https://www.kernel.org/pub"
BR2_GNU_MIRROR="http://ftp.gnu.org/pub/gnu"
BR2_PACKAGE_GLIBC_UTILS=y
BR2_ROOTFS_LIB_DIR="lib"
BR2_ROOTFS_LIB32_DIR="lib32"
BR2_TARGET_GENERIC_PASSWD_SHA512=y
BR2_ROOTFS_DEVICE_CREATION_DYNAMIC_EUDEV=y
BR2_TARGET_LOCALTIME="Europe/Berlin"
BR2_PACKAGE_LINUX_TOOLS_GPIO=y
BR2_PACKAGE_BUSYBOX_SHOW_OTHERS=y
BR2_PACKAGE_STRACE=y
BR2_PACKAGE_DOSFSTOOLS_FATLABEL=y
BR2_PACKAGE_DOSFSTOOLS_MKFS_FAT=y
BR2_PACKAGE_E2FSPROGS_E4DEFRAG=y
BR2_PACKAGE_EXFAT=y
BR2_PACKAGE_EXFAT_UTILS=y
BR2_PACKAGE_F2FS_TOOLS=y
BR2_PACKAGE_NTFS_3G=y
BR2_PACKAGE_DEJAVU=y
BR2_PACKAGE_LIBERATION=y
BR2_PACKAGE_PSPLASH=y
BR2_PACKAGE_PSPLASH_PATCH="$(BR2_EXTERNAL_EQ3_PATH)/patches/psplash/raspmatic"

BR2_PACKAGE_LINUX_FIRMWARE=y
BR2_PACKAGE_LINUX_FIRMWARE_RALINK_RT61=y
BR2_PACKAGE_LINUX_FIRMWARE_RALINK_RT73=y
BR2_PACKAGE_LINUX_FIRMWARE_RALINK_RT2XX=y
BR2_PACKAGE_LINUX_FIRMWARE_RTL_81XX=y
BR2_PACKAGE_LINUX_FIRMWARE_RTL_87XX=y
BR2_PACKAGE_LINUX_FIRMWARE_RTL_88XX=y

BR2_PACKAGE_RPI_BT_FIRMWARE=y
#!BR2_PACKAGE_RPI_FIRMWARE=y
BR2_PACKAGE_RPI_FIRMWARE_VERSION="1.20201022"
#!BR2_PACKAGE_RPI_WIFI_FIRMWARE=y
BR2_PACKAGE_I2C_TOOLS=y
BR2_PACKAGE_PARTED=y
#!BR2_PACKAGE_RNG_TOOLS=y
BR2_PACKAGE_RPI_USERLAND=y
BR2_PACKAGE_SMARTMONTOOLS=y
BR2_PACKAGE_MULTILIB32=y
BR2_PACKAGE_MULTILIB32_DEFCONFIG="multilib32_rpi3_defconfig"
#!BR2_PACKAGE_UBOOT_TOOLS=y
BR2_PACKAGE_UBOOT_TOOLS_MKIMAGE=y
BR2_PACKAGE_UBOOT_TOOLS_MKENVIMAGE=y
BR2_PACKAGE_UBOOT_TOOLS_DUMPIMAGE=y
#!BR2_PACKAGE_USB_MODESWITCH_DATA=y
BR2_PACKAGE_USBMOUNT=y
BR2_PACKAGE_NODEJS=y
BR2_PACKAGE_NODEJS_NPM=y
BR2_PACKAGE_NODEJS_MODULES_ADDITIONAL="async accepts mc charenc encodeurl inherits moment range-parser unorm adm-zip compress-commons end-of-stream ipaddr.js moment-timezone raw-body unpipe archiver concat-map escape-html is-buffer ms readable-stream url archiver-utils content-disposition etag isarray negotiator remove-trailing-separator util-deprecate array-flatten content-type express jmespath node-dir safe-buffer utils-merge async cookie finalhandler jsonfile node-localstorage sax uuid aws-sdk cookie-signature forwarded lazystream normalize-path send vary balanced-match core-util-is fresh lodash on-finished serve-static walkdir base64-js crc fs-extra loop-protect once setprototypeof winreg big-integer crc32-stream fs.realpath md5 parseurl slide wrappy bl cron glob media-typer path-is-absolute statuses write-file-atomic body-parser crypt graceful-fs merge-descriptors path-to-regexp string_decoder ws brace-expansion crypto-browserify http-errors methods process-nextick-args suncalc xml2js buffer debug iconv-lite mime proxy-addr tar-stream xmlbuilder buffer-crc32 depd ieee754 mime-db punycode type-is xtend buffer-shims destroy imurmurhash mime-types qs ultron zip-stream bytes ee-first inflight minimatch querystring universalify"
#!BR2_PACKAGE_CA_CERTIFICATES=y
BR2_PACKAGE_LIBOPENSSL_BIN=y
BR2_PACKAGE_FONTCONFIG=y
BR2_PACKAGE_DTC=y
BR2_PACKAGE_LIBGPIOD=y
BR2_PACKAGE_LIBGPIOD_TOOLS=y
BR2_PACKAGE_LIBUSB_COMPAT=y
BR2_PACKAGE_LIBCURL=y
BR2_PACKAGE_LIBCURL_CURL=y
BR2_PACKAGE_LIBNETFILTER_CONNTRACK=y
BR2_PACKAGE_MSMTP=y
BR2_PACKAGE_AVAHI=y
#!BR2_PACKAGE_BLUEZ5_UTILS=y
BR2_PACKAGE_BLUEZ5_UTILS_OBEX=y
#!BR2_PACKAGE_BLUEZ5_UTILS_CLIENT=y
BR2_PACKAGE_BLUEZ5_UTILS_DEPRECATED=y
BR2_PACKAGE_CHRONY=y
BR2_PACKAGE_ETHTOOL=y
BR2_PACKAGE_IFPLUGD=y
BR2_PACKAGE_IPTABLES=y
BR2_PACKAGE_IW=y
BR2_PACKAGE_LIGHTTPD=y
BR2_PACKAGE_LIGHTTPD_OPENSSL=y
BR2_PACKAGE_LIGHTTPD_ZLIB=y
BR2_PACKAGE_LIGHTTPD_PCRE=y
BR2_PACKAGE_NETSNMP=y
BR2_PACKAGE_NETSNMP_WITH_MIB_MODULES="host ucd-snmp/dlmod ucd-snmp/diskio ucd-snmp/extensible ucd-snmp/pass mibII/mta_sendmail etherlike-mib/dot3StatsTable disman/event-mib agentx"
BR2_PACKAGE_NTP=y
# BR2_PACKAGE_NTP_NTPD is not set
BR2_PACKAGE_NTP_NTPDATE=y
BR2_PACKAGE_OPENSSH=y
BR2_PACKAGE_OPENVPN=y
BR2_PACKAGE_RSYNC=y
BR2_PACKAGE_SER2NET=y
BR2_PACKAGE_SOCAT=y
BR2_PACKAGE_TCPDUMP=y
BR2_PACKAGE_WGET=y
#!BR2_PACKAGE_WIREGUARD_LINUX_COMPAT=y
BR2_PACKAGE_WIREGUARD_TOOLS=y
BR2_PACKAGE_WPA_SUPPLICANT=y
BR2_PACKAGE_WPA_SUPPLICANT_AP_SUPPORT=y
BR2_PACKAGE_WPA_SUPPLICANT_AUTOSCAN=y
BR2_PACKAGE_WPA_SUPPLICANT_EAP=y
BR2_PACKAGE_WPA_SUPPLICANT_HOTSPOT=y
BR2_PACKAGE_WPA_SUPPLICANT_DEBUG_SYSLOG=y
BR2_PACKAGE_WPA_SUPPLICANT_WPS=y
BR2_PACKAGE_WPA_SUPPLICANT_WPA3=y
BR2_PACKAGE_WPA_SUPPLICANT_CLI=y
BR2_PACKAGE_WPA_SUPPLICANT_PASSPHRASE=y
BR2_PACKAGE_WPA_SUPPLICANT_DBUS=y
BR2_PACKAGE_WPA_SUPPLICANT_DBUS_INTROSPECTION=y
BR2_PACKAGE_XINETD=y
BR2_PACKAGE_FILE=y
BR2_PACKAGE_LOGROTATE=y
BR2_PACKAGE_IRQBALANCE=y
BR2_PACKAGE_KMOD_TOOLS=y
BR2_PACKAGE_MONIT=y
BR2_PACKAGE_NUT=y
BR2_PACKAGE_TAR=y
BR2_PACKAGE_UTIL_LINUX_BINARIES=y
BR2_PACKAGE_UTIL_LINUX_LOSETUP=y
BR2_PACKAGE_UTIL_LINUX_RFKILL=y
#!BR2_PACKAGE_UTIL_LINUX_ZRAMCTL=y
BR2_TARGET_ROOTFS_EXT2=y
BR2_TARGET_ROOTFS_EXT2_4=y
BR2_TARGET_ROOTFS_EXT2_SIZE="1G"
BR2_TARGET_ROOTFS_EXT2_MKFS_OPTIONS=""
# BR2_TARGET_ROOTFS_TAR is not set
#!BR2_TARGET_UBOOT=y
#!BR2_TARGET_UBOOT_BUILD_SYSTEM_KCONFIG=y
#!BR2_TARGET_UBOOT_CUSTOM_VERSION=y
#!BR2_TARGET_UBOOT_CUSTOM_VERSION_VALUE="2020.10"
BR2_TARGET_UBOOT_PATCH="$(BR2_EXTERNAL_EQ3_PATH)/board/raspberrypi3/uboot-patches"
BR2_TARGET_UBOOT_USE_CUSTOM_CONFIG=y
BR2_TARGET_UBOOT_CUSTOM_CONFIG_FILE="$(BR2_EXTERNAL_EQ3_PATH)/board/raspberrypi3/uboot_defconfig"
BR2_TARGET_UBOOT_NEEDS_DTC=y
BR2_TARGET_UBOOT_BOOT_SCRIPT=y
BR2_TARGET_UBOOT_BOOT_SCRIPT_SOURCE="$(BR2_EXTERNAL_EQ3_PATH)/board/raspberrypi3/boot.cmd"
#!BR2_PACKAGE_HOST_DOSFSTOOLS=y
BR2_PACKAGE_HOST_GENIMAGE=y
#!BR2_PACKAGE_HOST_MTOOLS=y
#!BR2_PACKAGE_HOST_UBOOT_TOOLS=y

## BR2_PACKAGE_RECOVERY_SYSTEM=y
## BR2_PACKAGE_RECOVERY_SYSTEM_CONFIG="recovery_rpi3_defconfig"
## BR2_PACKAGE_OCCU=y
## BR2_PACKAGE_OCCU_RF_PROTOCOL_HM_HMIP=y
## BR2_PACKAGE_OCCU_WEBUI=y
## BR2_PACKAGE_OCCU_WEBUI_REGAHSS_BETA=y
## BR2_PACKAGE_OCCU_HMSERVER=y
## BR2_PACKAGE_CLOUDMATIC=y
## BR2_PACKAGE_HMLANGW=y
## BR2_PACKAGE_GENERIC_RAW_UART=y
## BR2_PACKAGE_EQ3_CHAR_LOOP=y
## BR2_PACKAGE_RPI_RF_MOD=y
## BR2_PACKAGE_SUSVD=y
## BR2_PACKAGE_PIUSVD=y
## BR2_PACKAGE_PICOD=y
## BR2_PACKAGE_STROMPI2D=y
## BR2_PACKAGE_PIDESKTOPD=y
## BR2_PACKAGE_ARGONONED=y
## BR2_PACKAGE_DETECT_RADIO_MODULE=y
## BR2_PACKAGE_DAEMONIZE=y
## BR2_PACKAGE_SSDPD=y
## BR2_PACKAGE_EQ3CONFIGD=y
## BR2_PACKAGE_WIRINGPI_RPI=y
## BR2_PACKAGE_NEOSERVER=y
## BR2_PACKAGE_RNDADDTOENTCNT=y
## BR2_PACKAGE_RASPI_FANSHIM=y
## BR2_PACKAGE_JAVA_AZUL=y
```
